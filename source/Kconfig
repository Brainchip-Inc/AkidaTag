## source/Kconfig
```kconfig
#
# Copyright (c) 2018 Nordic Semiconductor
#
# SPDX-License-Identifier: LicenseRef-Nordic-5-Clause
#

source "Kconfig.zephyr"

menu "Akida Tag Application"

config SRAM_BUFFER_SIZE
    int "Allocate SRAM for BLE or raw audio sample capture"
    default 102400
    help
      Allocate SRAM for app use.
	  
config BATCH_SIZE
    int "Batch size"
    default 4
    help
      Batch size.	  
	  
config MFCC_METHOD
    int "MFCC computation method"
    default 1
    help
      MFCC computation method.

config AUDIO_CAPTURE_TEST
    bool "Raw Audio Capture Test"
    default n
    help
      Raw Audio Capture Test.

config MFCC_SAMPLE_COUNT
    int "MFCC sample count"
    default 320
    help
      Number of PCM samples used per MFCC frame.

config CHANNELS_PER_SAMPLE
    int "no of channel per sample"
    default 2
    help
      Number of channel used.
	
config SAMPLING_RATE
    int "Sampling Rate"
    default 16000
    help
      Sampling Rate.
	  
config AUDIO
    bool "Enable AUDIO"
    default n
    help
      This enables AUDIO.
	  
config AUDIO_DMIC
    bool "Enable DMIC"
    default n
    help
      This enables DMIC.

config AUDIO_BLOCK_MS
    int "Audio DMA block size (ms)"
    default 60
    help
      Default PDM capture block size in milliseconds. Must be a multiple of the
      MFCC hop (CONFIG_MFCC_SAMPLE_COUNT samples = 20 ms at 16 kHz) so MFCC
      framing stays aligned, and no larger than CONFIG_AUDIO_MAX_BLOCK_MS.
      Runtime-adjustable via the `app blkms` shell command. Smaller = lower
      latency but a faster capture cadence.

config AUDIO_MAX_BLOCK_MS
    int "Maximum audio DMA block size (ms)"
    default 80
    help
      Upper bound for the audio block size. The DMA mem-slab and the audio
      processing buffers are statically sized for this value, so a runtime
      `app blkms` change can never overrun them. Must be a multiple of 20.

config SYNC_MODE
    int "Enable Akida Sync"
    default 0
    help
      This enables Akida Sync.	  
	  
config BT_LBS_SECURITY_ENABLED
	bool "Enable security"
	default n
	select BT_SMP
	select BT_SETTINGS
	select FLASH
	select FLASH_PAGE_LAYOUT
	select FLASH_MAP
	select NVS
	select SETTINGS
	help
	  "Enable BLE security for the LED-Button service"

config DK_BOARD
    bool "Enable DK Board specific initialization"
    depends on BT
    help
      This enables the DK Board specific initialization.
config SPARK_BOARD
    bool "Enable spark Board specific initialization"
    help
      This enables the spark Board specific initialization.

config SYS_CPU_128MHZ
    bool "Run the nRF5340 application core at 128 MHz"
    default y if SPARK_BOARD
    help
      Raise the application-core HCLK divider to DIV1 so the CPU runs at its
      maximum 128 MHz instead of the 64 MHz reset default. Increases core
      dynamic power by roughly 2x. Only the CPU domain is affected; peripheral
      and system-timer clocks are unchanged.

config CURRENT_DEFAULT_RATE_HZ
    int "Default INA190 current-sense sampler rate (Hz)"
    default 100
    depends on SPARK_BOARD
    help
      Default rate of the background current/power/energy sampler.
      Runtime-adjustable via the `power rate` shell command.

config AKD_SPI_FREQ_HZ
    int "AKD1500 host SPI clock (Hz)"
    default 4000000 if SPARK_BOARD
    default 1400000
    help
      Boot-time nRF5340 -> AKD1500 SPI clock, applied once the device is
      confirmed alive during bring-up. Spark defaults to 4 MHz: HW testing found
      AKD1500 model programming (the DMA-config handshake) reliably works up to
      4 MHz but times out at the 8 MHz SPIM2 step, even though plain reads/SRAM
      tolerate 8 MHz. The nRF SPIM rounds down to discrete steps (1/2/4/8 MHz on
      SPIM2). Use the `spi_freq` shell command to re-characterise on your board.
      DK keeps the conservative 1.4 MHz default.

config SAMPLING_RATE
    int "Sampling Rate"
    default 16000
    help
      Sampling Rate.
      
config DEMO_APPS
    bool "Enable Feature KWS, Gyro"
    default n

config FEAT_B
    bool "Enable Feature B"
    default n

config FEAT_C
    bool "Enable Feature C"
    default n

config FEAT_D
    bool "Enable Feature D"
    default n

config IMU_USE_INTERRUPT
	bool "Use IMU interrupt mode"
	default y
	help
	  Enable interrupt-driven IMU data acquisition.
	  Disable to use polling mode.

config IMU_ACC_ODR
	int "Accelerometer ODR"
	default 5
	help
	  0=OFF, 1=12.5Hz, 2=26Hz, 3=52Hz, 4=104Hz,
	  5=208Hz, 6=416Hz, 7=833Hz, 8=1660Hz

config IMU_ACC_FS
	int "Accelerometer Full Scale"
	default 3
	help
	  0=±2g, 1=±16g, 2=±4g, 3=±8g

config IMU_GYRO_ODR
	int "Gyroscope ODR"
	default 5
	help
	  Same encoding as accel ODR

config IMU_GYRO_FS
	int "Gyroscope Full Scale"
	default 1
	help
	  0=250dps, 1=500dps, 2=1000dps, 3=2000dps

config IMU_FIFO_ACC_ODR
	int "FIFO Accel Batch Data Rate"
	default 5
	help
	  Same encoding as ODR

config IMU_FIFO_GYRO_ODR
	int "FIFO Gyro Batch Data Rate"
	default 5
	help
	  Same encoding as ODR

config IMU_ENABLE_THREAD
    bool "Enable IMU processing thread"
    default y
    help
      Enables creation of the IMU processing thread.
      When disabled, no IMU thread or stack is created.

config IMU_FIFO_WATERMARK
    int "IMU FIFO Watermark Level"
    default 32
    help
      FIFO watermark level (number of FIFO entries before interrupt).
      Allowed values: 8, 16, 32
config WDT_ENABLE
    bool "Enable watchdog"
    default n
    help
      Enables the application watchdog (WDT).
      When enabled, the watchdog will be initialized during system
      startup and periodically fed by the application threads.
      When disabled, watchdog initialization and feeding will be
      skipped.
config APP_WDT_TIMEOUT_MS
    int "Application watchdog timeout in milliseconds"
    default 8000
    help
      Watchdog timeout value used by the application.

config CAMERA_ENABLE_THREAD
    bool "Enable dedicated camera processing thread"
    default y
    help
      Enables a separate thread for camera frame processing.


endmenu
```

## src/Kconfig
```kconfig
#
# Copyright (c) 2018 Nordic Semiconductor
#
# SPDX-License-Identifier: LicenseRef-Nordic-5-Clause
#

source "Kconfig.zephyr"

menu "AkidaTag Application"

config SRAM_BUFFER_SIZE
    int "Raw audio capture buffer size (bytes)"
    default 102400
    help
      Size of the buffer CONFIG_AUDIO_CAPTURE_TEST captures raw PCM into before
      dumping it over UART. Allocated only when that option is enabled. The BLE
      model transfer no longer shares it: it stages one flash sector, sized by
      MODEL_TRANSFER_BLOCK_SIZE in ble_services/file_transfer.h.
	  
config BATCH_SIZE
    int "Batch size"
    default 4
    help
      Batch size.	  
	  
config MFCC_METHOD
    int "MFCC computation method"
    default 1
    help
      MFCC computation method.

config AUDIO_CAPTURE_TEST
    bool "Raw Audio Capture Test"
    default n
    help
      Raw Audio Capture Test.

config MFCC_SAMPLE_COUNT
    int "MFCC sample count"
    default 320
    help
      Number of PCM samples used per MFCC frame.

config CHANNELS_PER_SAMPLE
    int "no of channel per sample"
    default 2
    help
      Number of channel used.
	
config SAMPLING_RATE
    int "Sampling Rate"
    default 16000
    help
      Sampling Rate.
	  
config AUDIO
    bool "Enable AUDIO"
    default n
    help
      This enables AUDIO.
	  
config AUDIO_DMIC
    bool "Enable DMIC"
    default n
    help
      This enables DMIC.

config AUDIO_BLOCK_MS
    int "Audio DMA block size (ms)"
    default 60
    help
      Default PDM capture block size in milliseconds. Must be a multiple of the
      MFCC hop (CONFIG_MFCC_SAMPLE_COUNT samples = 20 ms at 16 kHz) so MFCC
      framing stays aligned, and no larger than CONFIG_AUDIO_MAX_BLOCK_MS.
      Runtime-adjustable via the `app blkms` shell command. Smaller = lower
      latency but a faster capture cadence.

config AUDIO_MAX_BLOCK_MS
    int "Maximum audio DMA block size (ms)"
    default 80
    help
      Upper bound for the audio block size. The DMA mem-slab and the audio
      processing buffers are statically sized for this value, so a runtime
      `app blkms` change can never overrun them. Must be a multiple of 20.

config SYNC_MODE
    int "Enable Akida Sync"
    default 0
    help
      This enables Akida Sync.	  
	  
config BT_LBS_SECURITY_ENABLED
	bool "Enable security"
	default n
	select BT_SMP
	select BT_SETTINGS
	select FLASH
	select FLASH_PAGE_LAYOUT
	select FLASH_MAP
	select NVS
	select SETTINGS
	help
	  "Enable BLE security for the LED-Button service"

config DK_BOARD
    bool "Enable DK Board specific initialization"
    depends on BT
    help
      This enables the DK Board specific initialization.
config AKIDATAG_BOARD
    bool "Enable AkidaTag board specific initialization"
    help
      This enables the AkidaTag board specific initialization.

config SYS_CPU_128MHZ
    bool "Run the nRF5340 application core at 128 MHz"
    default y
    help
      Raise the application-core HCLK divider to DIV1 so the CPU runs at its
      maximum 128 MHz instead of the 64 MHz reset default. Increases core
      dynamic power by roughly 2x. Only the CPU domain is affected; peripheral
      and system-timer clocks are unchanged. REQUIRED for SPIM4 at 32 MHz
      (the Zephyr driver clamps SPIM4 to 16 MHz unless HFCLK is DIV1) — so this
      is now default y for the DK too, not just the AkidaTag board.

config CURRENT_DEFAULT_RATE_HZ
    int "Default INA190 current-sense sampler rate (Hz)"
    default 10
    depends on AKIDATAG_BOARD
    help
      Default rate of the background current/power/energy sampler. Kept low for
      a stable reading and low overhead; accurate spot values come from
      `power measure`. Runtime-adjustable via the `power rate` shell command.

choice
    prompt "INA190 current-sense variant"
    default INA190_VARIANT_A3 if BOARD_REVISION = "2"
    default INA190_VARIANT_A1
    depends on AKIDATAG_BOARD
    help
      Fitted INA190 amplifier variant. The A1/A3 difference is gain only
      (A1 = 25 V/V, A3 = 100 V/V); the shunt resistors are board parts. The
      variant cannot be auto-detected (analog part, no board ID), so the default
      follows the board revision the build selects: A1 on revision 1, A3 on
      revision 2. Runtime-overridable via `power variant`.

config INA190_VARIANT_A1
    bool "INA190A1RSW (gain 25 V/V)"

config INA190_VARIANT_A3
    bool "INA190A3RSW (gain 100 V/V)"

endchoice

config AKD_SPI_FREQ_HZ
    int "AKD1500 host SPI clock (Hz)"
    default 8000000
    help
      Boot-time nRF5340 -> AKD1500 host SPI clock (both boards), applied after the
      AKD1500 SPI_S core is routed onto the PLL (akd_core_clock_to_pll) and then
      scaled to 5x this clock (akd_spi_set_clock) to keep a 25% ¼-rule margin.
      HW-validated at 8/16/32 MHz on SPIM4 (H0H1 drive). The nRF SPIM4
      rounds down to discrete steps (…/8/16/32 MHz; 32 MHz needs the 128 MHz core,
      capped at 32 MHz). Runtime-tunable via `spi_freq`; an app can override this
      default in its own .conf.

config AKD_CORE_CLOCK_HZ
    int "AKD1500 core clock (Hz)"
    default 400000000
    help
      Boot-time AKD1500 internal core clock (both boards), applied once after the
      SPI_S core is routed onto the PLL. 400 MHz (the default) is the reset value
      so it is a no-op. Values that divide 800 MHz evenly change only the SYS_DIV
      divider (SPI untouched); other values reprogram the PLL. Lower clocks trade
      compute speed for power. Runtime-tunable via `akd_coreclk`.

config AKD_WAKE_SETTLE_US
    int "AKD1500 settle delay after de-asserting SLEEP (us)"
    default 100
    help
      Busy-wait applied after waking the AKD1500 (the 0->1 transition of the
      akd_wake_get() reference count, which de-asserts SLEEP) and before the
      first SPI transaction. Only paid when the chip was actually asleep.

      AN-002 (Sleep and Low-Power Operation) prescribes a settle here without
      giving a figure: it says "If the first access after wake is unreliable,
      add a short settle delay after de-asserting SLEEP before the first
      transaction". No numeric spec is available to us, so this default is
      reasoned rather than quoted. SLEEP is a pure clock gate and AN-002 states
      the PLL and dividers stay active through sleep ("Fast wake"), so recovery
      is a gate release rather than a PLL relock: the settle only has to cover a
      few cycles of the slowest clock in the path. 100 us is over 2000 cycles of
      the 25 MHz reference, and is negligible beside the flash operations it
      precedes (a 14-sector erase measures ~286 ms). Raise it if a first access
      after wake is ever seen to be unreliable.

config SAMPLING_RATE
    int "Sampling Rate"
    default 16000
    help
      Sampling Rate.
      
config DEMO_APPS
    bool "Enable Feature KWS, Gyro"
    default n

config FEAT_B
    bool "Enable Feature B"
    default n

config FEAT_C
    bool "Enable Feature C"
    default n

config FEAT_D
    bool "Enable Feature D"
    default n

config IMU_USE_INTERRUPT
	bool "Use IMU interrupt mode"
	default y
	help
	  Enable interrupt-driven IMU data acquisition.
	  Disable to use polling mode.

config IMU_ACC_ODR
	int "Accelerometer ODR"
	default 5
	help
	  0=OFF, 1=12.5Hz, 2=26Hz, 3=52Hz, 4=104Hz,
	  5=208Hz, 6=416Hz, 7=833Hz, 8=1660Hz

config IMU_ACC_FS
	int "Accelerometer Full Scale"
	default 3
	help
	  0=±2g, 1=±16g, 2=±4g, 3=±8g

config IMU_GYRO_ODR
	int "Gyroscope ODR"
	default 5
	help
	  Same encoding as accel ODR

config IMU_GYRO_FS
	int "Gyroscope Full Scale"
	default 1
	help
	  0=250dps, 1=500dps, 2=1000dps, 3=2000dps

config IMU_FIFO_ACC_ODR
	int "FIFO Accel Batch Data Rate"
	default 5
	help
	  Same encoding as ODR

config IMU_FIFO_GYRO_ODR
	int "FIFO Gyro Batch Data Rate"
	default 5
	help
	  Same encoding as ODR

config IMU_ENABLE_THREAD
    bool "Enable IMU processing thread"
    default y
    help
      Enables creation of the IMU processing thread.
      When disabled, no IMU thread or stack is created.

config IMU_FIFO_WATERMARK
    int "IMU FIFO Watermark Level"
    default 32
    help
      FIFO watermark level (number of FIFO entries before interrupt).
      Allowed values: 8, 16, 32
config WDT_ENABLE
    bool "Enable watchdog"
    default n
    help
      Enables the application watchdog (WDT).
      When enabled, the watchdog will be initialized during system
      startup and periodically fed by the application threads.
      When disabled, watchdog initialization and feeding will be
      skipped.
config APP_WDT_TIMEOUT_MS
    int "Application watchdog timeout in milliseconds"
    default 8000
    help
      Watchdog timeout value used by the application.

config CAMERA_ENABLE_THREAD
    bool "Enable dedicated camera processing thread"
    default y
    help
      Enables a separate thread for camera frame processing.


endmenu
```

## src/boards/brainchip/akidatag/Kconfig.defconfig
```kconfig
# Copyright (c) 2019-2020 Nordic Semiconductor ASA
# SPDX-License-Identifier: Apache-2.0

config HW_STACK_PROTECTION
	default ARCH_HAS_STACK_PROTECTION

if BOARD_AKIDATAG_NRF5340_CPUAPP

config BT_HCI_IPC
	default y if BT

config HEAP_MEM_POOL_ADD_SIZE_BOARD
	int
	default 4096 if BT_HCI_IPC

endif # BOARD_AKIDATAG_NRF5340_CPUAPP
```

## src/boards/brainchip/akidatag/board.yml
```yaml
board:
  name: akidatag
  full_name: AkidaTag
  vendor: brainchip
  socs:
  - name: nrf5340
  revision:
    format: number
    default: "1"
    exact: true
    revisions:
    - name: "1"
```
